/*******************************************************************************
*
* Autogenerated CAT-Events
* Don't edit manualy
*
*******************************************************************************/

	AB,
	AC,
	AG,
	AI,
	AM,
	AO,
	AV,
	BA,
	BC,
	BD,
	BI,
	BM,
	BP,
	BS,
	BU,
	BY,
	CF,
	CH,
	CN,
	CO,
	CS,
	CT,
	DA,
	DN,
	DT,
	ED,
	EM,
	EN,
	EU,
	EX,
	FA,
	FB,
	FN,
	GT,
	ID,
	IF,
	IS,
	KM,
	KP,
	KR,
	KS,
	KY,
	LK,
	LM,
	MA,
	MB,
	MC,
	MD,
	MG,
	ML,
	MR,
	MS,
	MT,
	MW,
	MX,
	NA,
	NB,
	NL,
	NR,
	OL,
	OS,
	PA,
	PB,
	PC,
	PL,
	PR,
	PS,
	QI,
	QR,
	QS,
	RA,
	RC,
	RD,
	RF,
	RG,
	RI,
	RL,
	RM,
	RS,
	RT,
	RU,
	SC,
	SD,
	SF,
	SH,
	SM,
	SQ,
	SS,
	ST,
	SV,
	TS,
	TX,
	UL,
	UP,
	VD,
	VG,
	VM,
	VS,
	VX,
	XT,
	ZI,


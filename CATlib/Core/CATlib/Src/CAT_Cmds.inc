/*
 * CAT_Cmds.inc
 *
 *  Created on: 18.04.2021
 *      Author: Harry L. (dd9dr)
 */

#ifndef CAT_SRC_CAT_CMDS_INC_
#define CAT_SRC_CAT_CMDS_INC_

	void CAT_AB_Cmd(CatEventMsg_t *Source);
	void CAT_AC_Cmd(CatEventMsg_t *Source);
	void CAT_AG_Cmd(CatEventMsg_t *Source);
	void CAT_AI_Cmd(CatEventMsg_t *Source);
	void CAT_AM_Cmd(CatEventMsg_t *Source);
	void CAT_AO_Cmd(CatEventMsg_t *Source);
	void CAT_AV_Cmd(CatEventMsg_t *Source);
	void CAT_BA_Cmd(CatEventMsg_t *Source);
	void CAT_BC_Cmd(CatEventMsg_t *Source);
	void CAT_BD_Cmd(CatEventMsg_t *Source);
	void CAT_BI_Cmd(CatEventMsg_t *Source);
	void CAT_BM_Cmd(CatEventMsg_t *Source);
	void CAT_BP_Cmd(CatEventMsg_t *Source);
	void CAT_BS_Cmd(CatEventMsg_t *Source);
	void CAT_BU_Cmd(CatEventMsg_t *Source);
	void CAT_BY_Cmd(CatEventMsg_t *Source);
	void CAT_CF_Cmd(CatEventMsg_t *Source);
	void CAT_CH_Cmd(CatEventMsg_t *Source);
	void CAT_CN_Cmd(CatEventMsg_t *Source);
	void CAT_CO_Cmd(CatEventMsg_t *Source);
	void CAT_CS_Cmd(CatEventMsg_t *Source);
	void CAT_CT_Cmd(CatEventMsg_t *Source);
	void CAT_DA_Cmd(CatEventMsg_t *Source);
	void CAT_DN_Cmd(CatEventMsg_t *Source);
	void CAT_DT_Cmd(CatEventMsg_t *Source);
	void CAT_ED_Cmd(CatEventMsg_t *Source);
	void CAT_EM_Cmd(CatEventMsg_t *Source);
	void CAT_EN_Cmd(CatEventMsg_t *Source);
	void CAT_EU_Cmd(CatEventMsg_t *Source);
	void CAT_EX_Cmd(CatEventMsg_t *Source);
	void CAT_FA_Cmd(CatEventMsg_t *Source);
	void CAT_FB_Cmd(CatEventMsg_t *Source);
	void CAT_FN_Cmd(CatEventMsg_t *Source);
	void CAT_GT_Cmd(CatEventMsg_t *Source);
	void CAT_ID_Cmd(CatEventMsg_t *Source);
	void CAT_IF_Cmd(CatEventMsg_t *Source);
	void CAT_IS_Cmd(CatEventMsg_t *Source);
	void CAT_KM_Cmd(CatEventMsg_t *Source);
	void CAT_KP_Cmd(CatEventMsg_t *Source);
	void CAT_KR_Cmd(CatEventMsg_t *Source);
	void CAT_KS_Cmd(CatEventMsg_t *Source);
	void CAT_KY_Cmd(CatEventMsg_t *Source);
	void CAT_LK_Cmd(CatEventMsg_t *Source);
	void CAT_LM_Cmd(CatEventMsg_t *Source);
	void CAT_MA_Cmd(CatEventMsg_t *Source);
	void CAT_MB_Cmd(CatEventMsg_t *Source);
	void CAT_MC_Cmd(CatEventMsg_t *Source);
	void CAT_MD_Cmd(CatEventMsg_t *Source);
	void CAT_MG_Cmd(CatEventMsg_t *Source);
	void CAT_ML_Cmd(CatEventMsg_t *Source);
	void CAT_MR_Cmd(CatEventMsg_t *Source);
	void CAT_MS_Cmd(CatEventMsg_t *Source);
	void CAT_MT_Cmd(CatEventMsg_t *Source);
	void CAT_MW_Cmd(CatEventMsg_t *Source);
	void CAT_MX_Cmd(CatEventMsg_t *Source);
	void CAT_NA_Cmd(CatEventMsg_t *Source);
	void CAT_NB_Cmd(CatEventMsg_t *Source);
	void CAT_NL_Cmd(CatEventMsg_t *Source);
	void CAT_NR_Cmd(CatEventMsg_t *Source);
	void CAT_OL_Cmd(CatEventMsg_t *Source);
	void CAT_OS_Cmd(CatEventMsg_t *Source);
	void CAT_PA_Cmd(CatEventMsg_t *Source);
	void CAT_PB_Cmd(CatEventMsg_t *Source);
	void CAT_PC_Cmd(CatEventMsg_t *Source);
	void CAT_PL_Cmd(CatEventMsg_t *Source);
	void CAT_PR_Cmd(CatEventMsg_t *Source);
	void CAT_PS_Cmd(CatEventMsg_t *Source);
	void CAT_QI_Cmd(CatEventMsg_t *Source);
	void CAT_QR_Cmd(CatEventMsg_t *Source);
	void CAT_QS_Cmd(CatEventMsg_t *Source);
	void CAT_RA_Cmd(CatEventMsg_t *Source);
	void CAT_RC_Cmd(CatEventMsg_t *Source);
	void CAT_RD_Cmd(CatEventMsg_t *Source);
	void CAT_RF_Cmd(CatEventMsg_t *Source);
	void CAT_RG_Cmd(CatEventMsg_t *Source);
	void CAT_RI_Cmd(CatEventMsg_t *Source);
	void CAT_RL_Cmd(CatEventMsg_t *Source);
	void CAT_RM_Cmd(CatEventMsg_t *Source);
	void CAT_RS_Cmd(CatEventMsg_t *Source);
	void CAT_RT_Cmd(CatEventMsg_t *Source);
	void CAT_RU_Cmd(CatEventMsg_t *Source);
	void CAT_SC_Cmd(CatEventMsg_t *Source);
	void CAT_SD_Cmd(CatEventMsg_t *Source);
	void CAT_SF_Cmd(CatEventMsg_t *Source);
	void CAT_SH_Cmd(CatEventMsg_t *Source);
	void CAT_SM_Cmd(CatEventMsg_t *Source);
	void CAT_SQ_Cmd(CatEventMsg_t *Source);
	void CAT_SS_Cmd(CatEventMsg_t *Source);
	void CAT_ST_Cmd(CatEventMsg_t *Source);
	void CAT_SV_Cmd(CatEventMsg_t *Source);
	void CAT_TS_Cmd(CatEventMsg_t *Source);
	void CAT_TX_Cmd(CatEventMsg_t *Source);
	void CAT_UL_Cmd(CatEventMsg_t *Source);
	void CAT_UP_Cmd(CatEventMsg_t *Source);
	void CAT_VD_Cmd(CatEventMsg_t *Source);
	void CAT_VG_Cmd(CatEventMsg_t *Source);
	void CAT_VM_Cmd(CatEventMsg_t *Source);
	void CAT_VS_Cmd(CatEventMsg_t *Source);
	void CAT_VX_Cmd(CatEventMsg_t *Source);
	void CAT_XT_Cmd(CatEventMsg_t *Source);
	void CAT_ZI_Cmd(CatEventMsg_t *Source);

const CatCmd_t CatCmds[] =
{
#include "GlobalEvents.inc"
	{ AB, "AB", &CAT_AB_Cmd },
	{ AC, "AC", &CAT_AC_Cmd },
	{ AG, "AG", &CAT_AG_Cmd },
	{ AI, "AI", &CAT_AI_Cmd },
	{ AM, "AM", &CAT_AM_Cmd },
	{ AO, "AO", &CAT_AO_Cmd },
	{ AV, "AV", &CAT_AV_Cmd },
	{ BA, "BA", &CAT_BA_Cmd },
	{ BC, "BC", &CAT_BC_Cmd },
	{ BD, "BD", &CAT_BD_Cmd },
	{ BI, "BI", &CAT_BI_Cmd },
	{ BM, "BM", &CAT_BM_Cmd },
	{ BP, "BP", &CAT_BP_Cmd },
	{ BS, "BS", &CAT_BS_Cmd },
	{ BU, "BU", &CAT_BU_Cmd },
	{ BY, "BY", &CAT_BY_Cmd },
	{ CF, "CF", &CAT_CF_Cmd },
	{ CH, "CH", &CAT_CH_Cmd },
	{ CN, "CN", &CAT_CN_Cmd },
	{ CO, "CO", &CAT_CO_Cmd },
	{ CS, "CS", &CAT_CS_Cmd },
	{ CT, "CT", &CAT_CT_Cmd },
	{ DA, "DA", &CAT_DA_Cmd },
	{ DN, "DN", &CAT_DN_Cmd },
	{ DT, "DT", &CAT_DT_Cmd },
	{ ED, "ED", &CAT_ED_Cmd },
	{ EM, "EM", &CAT_EM_Cmd },
	{ EN, "EN", &CAT_EN_Cmd },
	{ EU, "EU", &CAT_EU_Cmd },
	{ EX, "EX", &CAT_EX_Cmd },
	{ FA, "FA", &CAT_FA_Cmd },
	{ FB, "FB", &CAT_FB_Cmd },
	{ FN, "FN", &CAT_FN_Cmd },
	{ GT, "GT", &CAT_GT_Cmd },
	{ ID, "ID", &CAT_ID_Cmd },
	{ IF, "IF", &CAT_IF_Cmd },
	{ IS, "IS", &CAT_IS_Cmd },
	{ KM, "KM", &CAT_KM_Cmd },
	{ KP, "KP", &CAT_KP_Cmd },
	{ KR, "KR", &CAT_KR_Cmd },
	{ KS, "KS", &CAT_KS_Cmd },
	{ KY, "KY", &CAT_KY_Cmd },
	{ LK, "LK", &CAT_LK_Cmd },
	{ LM, "LM", &CAT_LM_Cmd },
	{ MA, "MA", &CAT_MA_Cmd },
	{ MB, "MB", &CAT_MB_Cmd },
	{ MC, "MC", &CAT_MC_Cmd },
	{ MD, "MD", &CAT_MD_Cmd },
	{ MG, "MG", &CAT_MG_Cmd },
	{ ML, "ML", &CAT_ML_Cmd },
	{ MR, "MR", &CAT_MR_Cmd },
	{ MS, "MS", &CAT_MS_Cmd },
	{ MT, "MT", &CAT_MT_Cmd },
	{ MW, "MW", &CAT_MW_Cmd },
	{ MX, "MX", &CAT_MX_Cmd },
	{ NA, "NA", &CAT_NA_Cmd },
	{ NB, "NB", &CAT_NB_Cmd },
	{ NL, "NL", &CAT_NL_Cmd },
	{ NR, "NR", &CAT_NR_Cmd },
	{ OL, "OL", &CAT_OL_Cmd },
	{ OS, "OS", &CAT_OS_Cmd },
	{ PA, "PA", &CAT_PA_Cmd },
	{ PB, "PB", &CAT_PB_Cmd },
	{ PC, "PC", &CAT_PC_Cmd },
	{ PL, "PL", &CAT_PL_Cmd },
	{ PR, "PR", &CAT_PR_Cmd },
	{ PS, "PS", &CAT_PS_Cmd },
	{ QI, "QI", &CAT_QI_Cmd },
	{ QR, "QR", &CAT_QR_Cmd },
	{ QS, "QS", &CAT_QS_Cmd },
	{ RA, "RA", &CAT_RA_Cmd },
	{ RC, "RC", &CAT_RC_Cmd },
	{ RD, "RD", &CAT_RD_Cmd },
	{ RF, "RF", &CAT_RF_Cmd },
	{ RG, "RG", &CAT_RG_Cmd },
	{ RI, "RI", &CAT_RI_Cmd },
	{ RL, "RL", &CAT_RL_Cmd },
	{ RM, "RM", &CAT_RM_Cmd },
	{ RS, "RS", &CAT_RS_Cmd },
	{ RT, "RT", &CAT_RT_Cmd },
	{ RU, "RU", &CAT_RU_Cmd },
	{ SC, "SC", &CAT_SC_Cmd },
	{ SD, "SD", &CAT_SD_Cmd },
	{ SF, "SF", &CAT_SF_Cmd },
	{ SH, "SH", &CAT_SH_Cmd },
	{ SM, "SM", &CAT_SM_Cmd },
	{ SQ, "SQ", &CAT_SQ_Cmd },
	{ SS, "SS", &CAT_SS_Cmd },
	{ ST, "ST", &CAT_ST_Cmd },
	{ SV, "SV", &CAT_SV_Cmd },
	{ TS, "TS", &CAT_TS_Cmd },
	{ TX, "TX", &CAT_TX_Cmd },
	{ UL, "UL", &CAT_UL_Cmd },
	{ UP, "UP", &CAT_UP_Cmd },
	{ VD, "VD", &CAT_VD_Cmd },
	{ VG, "VG", &CAT_VG_Cmd },
	{ VM, "VM", &CAT_VM_Cmd },
	{ VS, "VS", &CAT_VS_Cmd },
	{ VX, "VX", &CAT_VX_Cmd },
	{ XT, "XT", &CAT_XT_Cmd },
	{ ZI, "ZI", &CAT_ZI_Cmd },
    { NOP, "  ", NULL } };


#endif /* CAT_SRC_CAT_CMDS_INC_ */
